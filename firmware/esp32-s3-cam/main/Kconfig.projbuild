## firmware/esp32-s3-cam/main/Kconfig.projbuild
```kconfig
menu "Parking Lot Camera"

    config DISPLAY_ENABLE
        bool "Enable the on-device status display (ST7789 240x240)"
        default y
        help
            Turn this off when the TFT is not fitted.

            The panel costs internal RAM (a 7.5 KB DMA bounce buffer per flush,
            plus the SPI bus and driver state) and real time in the display
            task. With the screen absent that is pure waste, and internal RAM is
            the scarcest resource on this board.

            With this off, display_init() returns immediately: no frame buffer is
            allocated, the SPI bus and the panel driver are never initialised, no
            display task is created, and every display_show_*() call becomes a
            no-op because there is no queue to post to. The camera node is
            unaffected.

    config STREAM_MAX_FPS
        int "Camera stream frame rate cap (fps, 0 = uncapped)"
        range 0 30
        default 0
        help
            Frames per second the MJPEG stream is paced to. 0 disables pacing (the default).

            Was set to 12 to cut transmit airtime while the board seemed to be browning out. The
            board browned out at 12 anyway, and the camera does 24-27 fps at 800x600, so the cap was
            paying for nothing: quality first. Set a number only if the uplink or the supply turns
            out to need it, and remember every client shares whatever this allows (12 gives each of
            N viewers 12/N). Resolution is not touched either way: the bay calibration is in 800x600
            pixels.

    config WIFI_MAX_TX_POWER_DBM
        int "Wi-Fi maximum transmit power (dBm)"
        range 2 20
        default 10
        help
            Cap on the Wi-Fi transmit power, in dBm. 6 by default, not the 20 the
            hardware allows, and that is deliberate.

            Was tried at 6 and reverted: the RSSI on the status page is the *downlink*, and it
            looked excellent either way, but the *uplink* at 6 dBm was marginal - association
            succeeded and then the link took about three minutes to settle, with pings answering in
            1-2 s while it did. That is not an acceptable start-up. 10 dBm is the value that was
            measured working; the current reduction is done with STREAM_MAX_FPS instead, which does
            not touch the link quality at all.
            NOTE: sdkconfig is the file the build actually uses, and an existing one does not
            follow this default. Change both.

            This board's 3.3 V rail cannot carry the current spikes of a 20 dBm
            transmit burst. The evidence is a hardware comparison, not a guess: with
            the identical firmware, the stream delivers ~185 KB/s when the LCD module
            is plugged in and ~0.6 KB/s when it is not. The LCD is acting as extra
            decoupling capacitance, which is exactly what a sagging rail needs.

            A weak rail hits the uplink only, because receiving is cheap and
            transmitting is what draws the current, and it shows up as every one of
            these at once:
              - the AP's signal reads strong (-33 dBm) while the board struggles to
                be heard
              - small pings get 0% loss but 66-154 ms round trips (retries)
              - a 1.2 KB HTTP page completes in 0.19 s, while 11.7 KB JPEG frames
                wedge the socket (send timed out, EAGAIN)
              - ping loss 15% before the modem-sleep fix, 0% after, throughput still
                wrong

            The real fix is electrical - a better supply, a short thick cable, or a
            bulk capacitor (470-1000 uF plus 100 nF) across the 3.3 V pins. This
            setting only reduces the size of the current spikes so the board keeps
            working in the meantime. Lower it further (8, or even 2) if the link is
            still unreliable; the access point is close enough that the link budget
            is not the limiting factor.

            The value actually in force is read back from the driver and printed in
            the diagnostics line as tx=<dBm>.

    config OTA_MANIFEST_URL
        string "OTA manifest URL"
        default "http://192.168.3.102:8000/manifest.json"
        help
            Full URL of the thin OTA server's manifest.json.

            THIS IS THE ONLY PLACE IN THE FIRMWARE THAT CONTAINS AN OTA SERVER
            ADDRESS. Do not add a second copy anywhere else: no source file,
            no sdkconfig.defaults, no README snippet that people copy from.
            tools/ota-server/run.sh prints the correct value for this machine
            when it starts.

            The address is baked in at build time, so moving the OTA server to a
            different host or network means rebuilding. That is accepted
            deliberately - the alternative would be a discovery mechanism, and
            the device pull model is meant to stay this thin.

            To make a mismatch easy to spot, the value is logged at startup
            ("ota: manifest URL = ...") and shown on the device status page.

            Plain http:// is the intended sandbox-LAN setting. The downloaded
            image is always SHA256-verified against the manifest before it is
            committed, so HTTP is not trusted blindly. An https:// URL also
            works and is validated against the ESP x509 root bundle.

endmenu

menu "Parking Lot Bay Lights (WS2812B)"

    config LED_ENABLE
        bool "Drive the bay status lights"
        default y
        help
            One WS2812B ("2812") pixel per parking bay, on the strip wired to
            LED_GPIO. This is the 车位状态灯: green = EMPTY, red = OCCUPIED,
            yellow = reserved for navigation, dark = UNKNOWN or no data.

            See led.h for the two rules this module will not break (UNKNOWN is
            dark, never green; a failed poll blanks the strip instead of holding
            the last frame).

            This is the only module in the firmware that reads a business
            document from the PC. It only reads: the device pulls the state
            document over HTTP and never accepts an inbound business request,
            so the camera node still speaks first and still has no listening
            business interface.

    config LED_SELFTEST
        bool "Light the strip up on boot to prove it works"
        default y
        help
            Runs a bring-up pattern once, in the led task, before the module does
            anything else:

              walk     one pixel at a time from DIN outwards - count them, and see
                       whether pixel 0 is the one nearest the plug (if nothing
                       lights, the strip is being fed from its OUTPUT end)
              colours  green, red, yellow - the three semantics this module uses
              ramp     brightness up and down, the phase that fails electrically

            Everything needed to judge this is on the strip, so no second firmware
            project is needed to test the hardware.

            Turn it off once the strip is confirmed: it costs about 10 seconds of
            churn at every boot, and it lights the whole strip (about 0.7 A for 48
            pixels) which is not what a finished installation should do on power
            up.

            The ramp stops at 64/255 on purpose. 255 would be ~2.9 A and is how a
            marginal supply gets browned out in the middle of a demo - raise it
            only when reproducing a rail problem deliberately.

    config LED_GPIO
        int "Data pin (DIN)"
        default 14
        help
            GPIO driving the strip's DIN. GPIO14 is the only free pin on this
            board that is also broken out on the P1 header (camera 4-13/15-18,
            TFT 19/20/21/38/45/47, console UART 43/44, flash + octal PSRAM
            26-37, audio 1/2/39-42).

            RMT drives it, and RMT is free: the camera XCLK owns LEDC timer and
            channel 0, the TFT backlight owns timer and channel 1.

    config LED_COUNT
        int "Number of pixels on the strip"
        default 48
        help
            How many pixels are actually soldered to the strip. Frames are always
            sent for the whole strip, so a value larger than the real count costs
            nothing but a few milliseconds of shifting, and a smaller one shifts
            every bay by however many pixels were left out.

            The default is the number of bays in this lot (48). Do not trust it:
            count the pixels with LED_SELFTEST, which lights them one at a time
            and prints the index of each.

    config LED_ORDER
        string "Bay id per pixel, in strip order"
        default "9,10,11,12,13,14,15,16,17,18,19,20,21,22,23,24,25,26,27,28,29,30,31,32,33,34,35,36,37,38,39,40,41,42,43,44,45,46,47,48,49,50,B6,B5,B4,B3,B2,B1"
        help
            Comma separated bay ids, position = pixel index, starting at the
            pixel nearest DIN. Empty means the lights are disabled and the reason
            is logged at boot.

            The value above is the real installation on this sandbox (measured by
            watching LED_SELFTEST's walk and writing down which bay each pixel
            sits next to). It is the default here, not in sdkconfig.defaults, for
            the same reason the OTA URL is: exactly one source of truth, and a
            clone that builds and works.

            It is deliberately NOT inferred from parking_map.json: which pixel
            sits next to which bay is a fact about where the strip was glued
            down, and the map does not know it. The map's own order is only a
            starting point:

                python3 -c "import json;print(','.join(\
                  s['id'] for s in json.load(\
                    open('vision/out/parking_map.json'))['spots']))"

            Bay ids the state document does not contain are left dark, so a typo
            shows up as one unlit pixel instead of an invented free bay. That is
            how a '3' that should have been a '9' was caught.

            Re-measure after moving the strip, adding bays, or re-gluing pixels.

    config LED_STATE_URL
        string "State document URL (parking_state.json)"
        default "http://192.168.3.102:8010/out/parking_state.json"
        help
            Full URL of the live parking_state/1 document. src/serve.py serves it
            next to the web pages.

            This is the second baked-in PC address in the firmware, and it is a
            separate setting from CONFIG_OTA_MANIFEST_URL on purpose: the OTA
            server and the vision server are different processes and may live on
            different machines. Keep each address in exactly one place - no
            README snippet is the source of truth for either.

            NOTE: src/serve.py binds 127.0.0.1 by default, so it is not reachable
            from the device until it is started with --host 0.0.0.0. Do that
            deliberately: that handler serves the whole vision/ directory, not
            just this document.

    config LED_ROUTE_URL
        string "Route document URL (route.json)"
        default "http://192.168.3.102:8010/out/route.json"
        help
            Full URL of the route/1 document that src/serve.py writes when the page
            plans a route. The firmware reads exactly two fields from it, in this
            order: "ok", then "target_spot". The bay at target_spot turns yellow.

            "ok" is checked first and it is not a formality: a refused plan names the
            bay that was asked for with ok == false, and so does the "navigation
            ended" document (GET /api/route?clear=1) the page sends when a navigation
            is cancelled or the car arrives. Reading target_spot without checking ok
            would light up a bay you were told you cannot drive to, and would leave
            the last target lit forever after a navigation ends.

            A bay that is both the target and OCCUPIED shows red, not yellow: yellow
            means "come here", and the two states correcting each other is the point.

            This is the same host as LED_STATE_URL. Both are listed separately
            because both are served by src/serve.py and that is what has to be
            reachable - see LED_STATE_URL for the --host 0.0.0.0 note.

    config LED_STATE_STALE_MS
        int "Treat the state document as stale after this long without a change (ms)"
        range 2000 120000
        default 10000
        help
            The device has no wall clock, so freshness is judged by movement: main.py
            rewrites the document every frame with a whole-second timestamp, so if the
            timestamp has not advanced in this long, nobody is writing it.

            A document that still arrives but no longer changes describes a moment that
            has passed. Showing it is the same lie as reporting UNKNOWN as EMPTY - just
            slower - so the strip blanks instead, exactly as it does when the fetch
            fails, and the log says which of the two happened.

            10 s is about 400 frames of margin. Lower it for a faster reaction, raise it
            if the vision loop is ever run with a much lower frame rate.

    config LED_POLL_MS
        int "Poll period (ms)"
        default 500
        range 100 10000
        help
            How often the state document is fetched. 500 ms matches what the web
            pages already poll at, so the lights and the page never disagree by
            more than one poll.

            Faster buys nothing: PC Vision's own cadence sets how fresh the
            document can be. Slower makes a bay change visible later than it is.

    config LED_BRIGHTNESS
        int "Pixel brightness"
        default 32
        range 1 255
        help
            Duty limit applied to every pixel, 32/255 (about 12%) by default.

            This is a power budget, not a taste setting. 48 pixels at full white
            would draw ~2.9 A, and this board is fed from USB or a small Li-ion
            cell. At 32/255 a single colour per pixel totals roughly 120 mA for
            all 48 - small enough to sit next to Wi-Fi and the camera on the same
            5 V rail.

            Raising this also shrinks the electrical margin on the data line:
            a strip powered at 5 V wants 3.5 V for a logic high and the ESP32
            drives 3.3 V. If pixels start showing the wrong colour, or the first
            pixel glitches, that is the margin - power the strip at 4.3-4.5 V or
            add a 74AHCT125, and see README 13.

endmenu

menu "UHF RFID (4D four-antenna reader)"

    config RFID_ENABLE
        bool "Poll the UHF RFID reader"
        default n
        help
            The module reports presence, not position: no phase, ~30 cm read radius. It answers
            "which tags are on the table" and at best "which antenna zone", never a bay coordinate.

            UART1 on GPIO1 (RX from the module) and GPIO2 (TX to it). UART0 on 43/44 stays the
            console - it is the only debugging channel this board has.

    config RFID_UART
        int "UART controller"
        range 1 2
        default 1

    config RFID_RX_GPIO
        int "RX GPIO (module TX connects here)"
        default 1

    config RFID_TX_GPIO
        int "TX GPIO (connects to module RX)"
        default 2

    config RFID_POLL_MS
        int "Poll period (ms)"
        range 50 2000
        default 200

    config RFID_LOG_MS
        int "Minimum gap between log lines for the same tag (ms)"
        range 0 10000
        default 1000

    config RFID_ANTENNA_PROBE
        bool "Run a one-shot antenna probe at boot (temporary, for validation)"
        default n
        help
            For each of the four ports: select it, then one single inventory, and stop reading when
            a complete checksum-valid frame has arrived - not after a fixed dwell. The timeout is
            only a fault guard. Twenty rounds per port, then a summary line.

            Enable this to answer "how long does the reader really take, per port" before choosing
            a scheduler. Leave off in normal use.

    config RFID_PROBE_ROUNDS
        int "Probe rounds per port"
        depends on RFID_ANTENNA_PROBE
        range 1 100
        default 20

    config RFID_PROBE_TIMEOUT_MS
        int "Probe transaction timeout (ms)"
        depends on RFID_ANTENNA_PROBE
        range 200 5000
        default 1000

    config RFID_ANTENNAS
        int "Antenna ports to rotate through (1 = no selection)"
        range 1 4
        default 4

    config RFID_SELECT_MS
        int "Settle time after switching antenna (ms)"
        range 10 500
        default 80

    config RFID_LISTEN_MS
        int "Listen window per poll (ms)"
        range 50 1000
        default 150

endmenu

menu "Geomagnetic bays (TCA9548A + magnetometers)"

    config MAG_ENABLE
        bool "Read the four bay magnetometers"
        default n
        help
            Four magnetometers behind a TCA9548A I2C multiplexer, one per channel. The mux is
            needed because the HMC5883L address (0x1E) is fixed and four of them on one bus would
            collide. Runs on I2C port 1: port 0 belongs to the camera's SCCB bus.

            Best effort. If nothing answers, the firmware logs it and every other peripheral keeps
            running.

    config MAG_I2C_PORT
        int "I2C controller"
        range 0 1
        default 0
        help
            Measured, not assumed: asking for port 1 broke the camera. esp32-camera installs its
            SCCB bus on port 1 on this build (CONFIG_SCCB_HARDWARE_I2C_PORT1=y), regardless of the
            sccb_i2c_port field in camera.c, so the magnetometers must take port 0.

    config MAG_SDA_GPIO
        int "SDA GPIO"
        default 41

    config MAG_SCL_GPIO
        int "SCL GPIO"
        default 42

    config MAG_HUB_ADDR
        hex "TCA9548A address (A0/A1/A2 to GND = 0x70)"
        default 0x70

    config MAG_CHANNELS
        int "Channels to probe (one sensor each)"
        range 1 8
        default 4

    config MAG_SAMPLE_HZ
        int "Samples per second per channel"
        range 1 50
        default 10

    config MAG_CLK_HZ
        int "I2C clock (Hz)"
        default 100000

endmenu

menu "Barrier Gate (servo + contact switch)"

    config GATE_ENABLE
        bool "Drive the barrier gate"
        default y
        help
            A contact switch on GATE_SENSOR_GPIO says a car is here, a servo on
            GATE_SERVO_GPIO lifts the arm, and the arm comes down again a few
            seconds after the switch is released.

            This is local automation and it is deliberately not wired to the
            network: the gate task is started at boot, not when Wi-Fi comes up,
            so it keeps working with the PC off. It never reads the parking
            state, and it publishes nothing.

            See main/gate.h for the pin audit. GPIO39/40 are the reference
            project's speaker I2S lines (this firmware never initialises audio)
            and are also the ESP32-S3's JTAG pins, so an external JTAG probe can
            no longer be attached. Crash backtraces still work: the GDB stub uses
            the console UART.

    config GATE_SENSOR_GPIO
        int "Switch input pin"
        default 39
        help
            One side of the switch to this pin, the other to GND. The internal
            pull-up supplies the level; the switch draws about 73 uA when closed,
            so it has no effect on anything else in the system.

            GPIO39 is also where a TCRT5000's DO would go later, with no code
            change: both parts are "active low when something is there". The
            TCRT5000 must be powered from 3.3 V, never 5 V - the pin is not
            5 V tolerant.

    config GATE_SERVO_GPIO
        int "Servo signal pin"
        default 40
        help
            Servo PWM, generated by LEDC TIMER_2 / CHANNEL_2 at 50 Hz. That timer
            is free: TIMER_0/CH0 is the camera XCLK and TIMER_1/CH1 is the TFT
            backlight. A timer's frequency belongs to that timer alone, so the
            servo cannot disturb either of them.

            Do not power the servo from this pin, and do not power it from the
            board at all if it is a metal-gear servo: see GATE_HOLD_MS.

    config GATE_SENSOR_ACTIVE_LOW
        bool "Switch pulls the pin low when triggered"
        default y
        help
            Yes for a switch to GND, which is the intended wiring, and also for
            a TCRT5000 module's DO. Turn this off for a source that pulls the pin
            high instead.

    config GATE_DEBOUNCE_MS
        int "Debounce time (ms)"
        range 10 1000
        default 100
        help
            How long the input has to hold a new level before it counts. A
            mechanical contact bounces for a few milliseconds; this also absorbs
            a hand brushing the switch. The input is sampled every 20 ms.

    config GATE_HOLD_MS
        int "Keep the arm up this long after the switch is released (ms)"
        range 500 600000
        default 5000
        help
            The arm stays up for as long as the switch is pressed, and this
            countdown starts when it is released. Pressing again restarts the
            countdown, so a car that stops under the arm keeps it up - that is
            the anti-pinch, and it needs no second sensor.

            5 s is enough for a car to clear the gate and keeps a demo moving.

    config GATE_RAMP_MS
        int "Servo travel time (ms)"
        range 100 5000
        default 800
        help
            Movement is spread over this long instead of being applied in one
            step. A servo commanded straight to a new position draws close to its
            stall current for the whole of that first movement.

            This matters here because the servo shares its 5 V rail with the
            WS2812 strip, and the board's own 3.3 V comes off the same rail: a
            rail that sags takes the camera and the panel with it, or resets the
            board (rst:0x1 POWERON). Slower costs nothing on a barrier arm.

    config GATE_QR_ON_TRIGGER
        bool "Show the QR code while the gate is open"
        default y
        help
            A car has arrived, so the code goes in front of the person standing
            there with it - that is the hand-off to the phone: scan, pick a bay,
            drive.

            Its timing is deliberately separate from the arm's. The arm stays up
            because the car has to clear the gate (GATE_HOLD_MS); the code stays up
            because a person has to get a phone out and aim it (GATE_QR_LINGER_MS,
            counted from the moment the arm lands home). One number cannot serve
            both - whichever way it is set, the other is wrong.

            QR_SHOW_ON_BOOT is separate on purpose - it exists to check that the
            code scans at all, and once that is confirmed this is the trigger that
            should be doing it.

    config GATE_QR_LINGER_MS
        int "Keep the QR code up this long after the arm lands (ms)"
        depends on GATE_QR_ON_TRIGGER
        range 0 300000
        default 30000
        help
            30 s by default, counted from the arm reaching home - so with the
            default GATE_HOLD_MS the code is on screen from the trigger for about
            36 s in total.

            This is the number to raise when someone says they could not get their
            phone out in time, and it is the only one that needs raising: the arm
            lands on its own schedule and the gate is already free for the next car
            while the code is still up. Raising GATE_HOLD_MS instead would hold
            traffic to give the phone more time, which is the wrong trade.

            0 takes the code down the moment the arm lands. The range allows up to
            5 minutes for a demo where nobody is in a hurry.

    config GATE_START_PULSE_US
        int "First position commanded at boot (us)"
        range 500 2600
        default 1945
        help
            There is no position feedback on a servo: whatever pulse arrives first
            is a command, and the arm travels to it. Until the arm has been
            calibrated, the middle of the electrical range (1500 us) is the one
            place least likely to be a mechanical stop, so that is where it is sent
            first, and the move to the closed position is then a ramp.

            A servo driven into a stop stalls at 1.5-2.5 A. Set this to
            GATE_PULSE_CLOSED_US once the arm has been calibrated and there is
            nothing left to discover.

            Ignored while GATE_CALIBRATE is on: the sweep starts at
            GATE_CALIBRATE_FROM_US instead.

    config GATE_PULSE_CLOSED_US
        int "Closed position, pulse width (us)"
        range 500 2600
        default 1945
        help
            The arm's down position, in microseconds of pulse width. 1500 us is
            the usual electrical centre; 1000 and 2000 are a 90 degree swing
            around it, which is all a barrier arm needs and keeps both ends well
            away from the mechanical stops.

            Never command a position beyond what the arm can reach: a servo
            pushing against a stop is a stalled servo, and that is 1.5-2.5 A on
            this class of servo. Measure the two values instead of assuming them
            - see GATE_CALIBRATE.

    config GATE_PULSE_OPEN_US
        int "Open position, pulse width (us)"
        range 500 2600
        default 1055
        help
            The arm's up position. Must differ from GATE_PULSE_CLOSED_US.

    config GATE_CALIBRATE
        bool "Sweep the servo once at boot to measure the two positions"
        default n
        help
            A wide servo is not a promise: a "185 degree" unit is usually a
            modified 180 degree one whose ends are unreachable, and where the arm
            actually points depends on how the horn was fitted. So the two
            positions get measured.

            With this on, the servo sweeps FROM..TO in STEP steps, holding each
            for DWELL ms and printing the width, then parks closed and the gate
            runs normally. That sweep doubles as the "is this servo alive at all"
            test: it is slow, it covers the whole usable range, and it starts 300 us
            clear of the usual end so it cannot drive an unmeasured arm into a stop. Write the two widths you want into
            GATE_PULSE_CLOSED_US / GATE_PULSE_OPEN_US and turn this off.

            The window starts at 800 us, far from the ends, on purpose: the first
            sweep of an unmeasured arm should not be able to drive it into a stop.

    config GATE_CALIBRATE_FROM_US
        int "sweep from (us)"
        depends on GATE_CALIBRATE
        range 500 2600
        default 800

    config GATE_CALIBRATE_TO_US
        int "sweep to (us)"
        depends on GATE_CALIBRATE
        range 500 2600
        default 2200

    config GATE_CALIBRATE_STEP_US
        int "sweep step (us)"
        depends on GATE_CALIBRATE
        range 10 500
        default 50

    config GATE_CALIBRATE_DWELL_MS
        int "time per step (ms)"
        depends on GATE_CALIBRATE
        range 100 5000
        default 700

endmenu

menu "QR code on the status panel"

    config QR_SHOW_ON_BOOT
        bool "Show the test QR code at boot"
        default y
        help
            Displays the fixed test QR (main/qr_code.h) full screen for
            QR_BOOT_SECONDS at every boot, then puts the status screen back.

            It is shown before Wi-Fi comes up on purpose: a QR code that only
            appears on a healthy network cannot be checked when the network is
            what is being debugged.

            Turn this off once the code has been scanned and the real trigger
            (the gate) is what should bring it up.

    config QR_BOOT_SECONDS
        int "How long to show it (s)"
        depends on QR_SHOW_ON_BOOT
        range 5 600
        default 45
        help
            45 s because that is how long "pick up the phone, open the camera,
            aim it, focus" actually takes when someone is also holding a car.

            The code is 8 px per module with a 4 module quiet zone, which is the
            largest a version 1 code gets on a 240 px panel - see display.c
            draw_qr(). Change the payload and the header is regenerated with
            tools/make-qr-test.py; the scale follows the new version automatically.

endmenu

menu "Server discovery"

    config DISCOVERY_ENABLE
        bool "Find the PC by listening for its beacon"
        default y
        help
            The three server URLs and the QR code all name a PC whose address comes
            from DHCP, so moving the sandbox to another Wi-Fi used to mean a rebuild
            before anything worked again.

            With this on, the device listens on DISCOVERY_PORT for a small UDP
            broadcast from tools/beacon.py and uses the address that packet came
            from. Ports and paths are not touched - a service on another port is a
            different service, and that is configuration.

            It is an improvement, never a requirement: if no beacon is ever heard,
            or the last one is older than 15 s, every URL is used exactly as
            configured, so this can be left on permanently.

            Broadcasts do not cross a router, so the device and the PC have to share
            a subnet. That is the same condition plain HTTP already imposes here.

    config DISCOVERY_PORT
        int "Beacon UDP port"
        range 1024 65535
        default 9999
        help
            Must match tools/beacon.py (its --port, 9999 by default). Only the source
            address matters; the packet body is checked for a magic prefix so that
            unrelated broadcasts are ignored.

    config DISCOVERY_APPLY_OTA
        bool "Let the beacon redirect the OTA server as well"
        default n
        help
            Off by default, and the reason is asymmetric damage rather than a
            property of the beacon.

            The strip following a stranger's broadcast costs wrong colours. An OTA
            client following one costs whatever firmware that stranger serves, and
            the only check is a SHA256 that the same manifest supplies - there is no
            signature (README 11.5). On a sandbox LAN that is an acceptable trade for
            state colours and not an acceptable one for code execution.

            Turn it on only on a network where everyone broadcasting is yours.

endmenu
```
